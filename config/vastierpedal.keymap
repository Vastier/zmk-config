#include <behaviors.dtsi>
#include <dt-bindings/zmk/keys.h>
#include <dt-bindings/zmk/bt.h>

/ {  
    keymap {
        compatible = "zmk,keymap";

        default_layer {
            bindings = <
                &mo 1         &kp KP_F21     &kp KP_F22     &kp KP_F23
            >;
        }; 
        
        bt_layer {
            bindings = <
                &trans          &kp KP_F20      &kp KP_F24     &bootloader
            >;
        };
    };
};