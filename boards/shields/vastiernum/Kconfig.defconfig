## boards/shields/vastiernum/Kconfig.defconfig
```kconfig
if SHIELD_VASTIERNUM

config ZMK_KEYBOARD_NAME
    default "VastierNum"

endif # SHIELD_VASTIERNUM
```

## boards/shields/vastierpedal/Kconfig.defconfig
```kconfig
if SHIELD_VASTIERPEDAL

config ZMK_KEYBOARD_NAME
    default "vastierpedal"

endif # SHIELD_VASTIERPEDAL
```
